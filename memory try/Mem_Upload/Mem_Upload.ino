#include <SPI.h>

byte Screen [] = {
0x00, 0x00, 0xFF, 0xFF, 0xFF, 0x00, 0xFF, 0xFF, 0xFF, 0xFF, 0xFF, 0xFF, 0xFF, 0x00, 0x00, 0x00,
0x00, 0x00, 0x00, 0x00, 0x00, 0x00, 0x00, 0x00, 0x00, 0x00, 0x00, 0x00, 0x00, 0x00, 0x00, 0x00,
0x00, 0x00, 0x00, 0x00, 0x00, 0x00, 0x00, 0x00, 0x00, 0x00, 0x00, 0x00, 0x00, 0x00, 0x00, 0x00,
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0x00, 0x00, 0x00, 0x00, 0x55, 0x3C, 0x67, 0x5C, 0x75, 0x3A, 0x65, 0x5A, 0x2B, 0x55, 0x5D, 0x00
};


#define MEM_CS 8

#define WREN  6

void fmWriteEnable() {
  digitalWrite(MEM_CS, LOW);
  SPI.transfer(WREN);
  digitalWrite(MEM_CS, HIGH);
}

void setup() {

  delay(1000);

  Serial.begin(9600);
  Serial.println("Startup...");

  pinMode(MEM_CS, OUTPUT);
  digitalWrite(MEM_CS, HIGH);

  SPI.setDataMode(SPI_MODE0);
  SPI.setClockDivider(SPI_CLOCK_DIV4);
  SPI.begin();

}

void loop() {
  
//  Serial.println("128Mb SPI FLASH MEMORY RFID Block Erase Sector");
//  delay(1000);
//  fmWriteEnable();
//  digitalWrite(MEM_CS, LOW);
//  SPI.transfer(0x20);// WRITE
//  SPI.transfer(0);
//  SPI.transfer(0);
//  SPI.transfer(0x01);
//
//  digitalWrite(MEM_CS, HIGH);
  
//  delay(1000);
//  
//  Serial.println("128Mb SPI FLASH MEMORY RFID Block WRITE Page 1");
//  delay(1000);
//  fmWriteEnable();
//  digitalWrite(MEM_CS, LOW);
//  SPI.transfer(0x02);// WRITE
//  SPI.transfer(0);
//  SPI.transfer(0);
//  SPI.transfer(0x01);
//
//  for(int i = 0; i < 256; i++){
//   
//     SPI.transfer(0x1);
//    
//  }
//
//  digitalWrite(MEM_CS, HIGH);
  
  delay(1000);

  Serial.println("128Mb SPI FLASH MEMORY RFID PAGE READ test.....");
  delay(1000);
  digitalWrite(MEM_CS, LOW);
  SPI.transfer(0x13);//READ);
  SPI.transfer(0);
  SPI.transfer(0);
  SPI.transfer(0x01);

  for (int i = 0x00; i < 256; i++) {
    byte b = SPI.transfer(0);
    if (b < 0x10) Serial.print("0");
    Serial.print(b, HEX);
    Serial.print(" ");
  }

  digitalWrite(MEM_CS, HIGH);
  
   delay(1000);

  Serial.println("128Mb SPI FLASH MEMORY RFID PAGE READ test2.....");
  delay(1000);
  digitalWrite(MEM_CS, LOW);
  SPI.transfer(0x13);//READ);
  SPI.transfer(0);
  SPI.transfer(0);
  SPI.transfer(0x01);

  for (int i = 0x00; i < 256; i++) {
    byte b = SPI.transfer(0);
    if (b < 0x10) Serial.print("0");
    Serial.print(b, HEX);
    Serial.print(" ");
  }

  digitalWrite(MEM_CS, HIGH);
  
  
  while(1);

}
